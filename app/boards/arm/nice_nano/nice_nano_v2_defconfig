## app/boards/arm/nice_nano/nice_nano_v2_defconfig
```kconfig
# SPDX-License-Identifier: MIT

CONFIG_SOC_SERIES_NRF52X=y
CONFIG_SOC_NRF52840_QIAA=y
CONFIG_BOARD_NICE_NANO_V2=y

# Enable MPU
CONFIG_ARM_MPU=y

# enable GPIO
CONFIG_GPIO=y

# USB Configuration
CONFIG_ZMK_USB=y           # Enable USB functionality
CONFIG_ZMK_SPLIT=y         # Enable split keyboard functionality
CONFIG_ZMK_SPLIT_BLE=y     # Enable Bluetooth split functionality
CONFIG_ZMK_SPLIT_ROLE_CENTRAL=y  # Set role to central for BLE

CONFIG_USE_DT_CODE_PARTITION=y

CONFIG_MPU_ALLOW_FLASH_WRITE=y
CONFIG_NVS=y
CONFIG_SETTINGS_NVS=y
CONFIG_FLASH=y
CONFIG_FLASH_PAGE_LAYOUT=y
CONFIG_FLASH_MAP=y
```

## app/drivers/zephyr/dts/bindings/sensor/pimoroni,trackball_pim447.yaml
```yaml
# Copyright (c) 2021 The ZMK Contributors
# SPDX-License-Identifier: MIT

description: Trackball PIM447

# compatible: "pimoroni,trackball_pim447"
/ {
    compatible = "pimoroni,trackball_pim447";
    ...
};

# properties:
#   label:
#     type: string
#     required: true
# 수정 후
properties:
  # label 속성을 제거합니다.    


  reg:
    type: int
    required: true

  move-factor:
    type: int
    required: false
    default: 1

  invert-move-x:
    type: boolean
    required: false

  invert-move-y:
    type: boolean
    required: false

  button:
    type: int
    required: false
    default: 0

  swap-axes:
    type: boolean
    required: false

  scroll-divisor:
    type: int
    required: false
    default: 2

  invert-scroll-x:
    type: boolean
    required: false

  invert-scroll-y:
    type: boolean
    required: false

  mode:
    type: int
    required: false
    default: 1
    enum:
      - 1
      - 2
```

## app/dts/bindings/trackball_pim447.yaml
```yaml
# zmk/app/dts/bindings/pimoroni,trackball_pim447.yaml

pimoroni,trackball_pim447:
  type: "object"
  properties:
    compatible:
      const: "pimoroni,trackball_pim447"
    reg:
      description: "I2C address"
      type: "array"
      items:
        - description: "I2C address"
          type: "integer"
    move-factor:
      description: "Pointer movement factor"
      type: "integer"
    button:
      description: "Button configuration"
      type: "integer"
    scroll-divisor:
      description: "Scroll wheel divisor"
      type: "integer"
    mode:
      description: "Trackball mode"
      type: "integer"
  required:
    - compatible
    - reg
```

## config/boards/shields/trackball_pim447/Kconfig.defconfig
```kconfig
if SHIELD_TRACKBALL_PIM447

config ZMK_KEYBOARD_NAME
    default "Trackball_pim447"

config ZMK_MOUSE
    default y

config I2C
    default y

config ZMK_TRACKBALL_PIM447
    bool "Enable PIM447 Trackball"
    default y
    help
        Enable support for the PIM447 trackball.

endif
```

## config/boards/shields/trackball_pim447/Kconfig.shield
```kconfig
config SHIELD_TRACKBALL_PIM447
    def_bool $(shields_list_contains,trackball_pim447)
```

## config/dts/bindings/behaviors/zmk,behavior-mouse-scroll.yaml
```yaml
description: Mouse scroll

compatible: "zmk,behavior-mouse-scroll"

include: one_param.yaml

properties:
  delay-ms:
    type: int
  time-to-max-speed-ms:
    type: int
  acceleration-exponent:
    type: int
  15 changes: 15 additions & 0 deletions15 
```
