&pro_micro_i2c {
    status = "okay";  // I2C 버스 활성화
    scl-gpio = <&pro_micro 20>;  // SCL 핀을 GPIO 20에 설정
    sda-gpio = <&pro_micro 17>;  // SDA 핀을 GPIO 17에 설정

    trackball_pim447@a {
        compatible = "pimoroni,trackball_pim447";  // 드라이버와 일치
        reg = <0xa>;  // I2C 주소
        label = "TRACKBALL_PIM447";  // 트랙볼 레이블

        // Optional properties for the trackball configuration
        move-factor = <2>;  // 포인터 속도 증가 (기본값: 1)
        invert-move-x;  // X 축 반전
        invert-move-y;  // Y 축 반전
        button = <1>;  // 볼을 눌렀을 때 오른쪽 클릭 전송
        swap-axes;  // X 및 Y 축 교환
        scroll-divisor = <1>;  // 휠 속도 증가 (기본값: 2)
        invert-scroll-x;  // 휠 X 축 반전
        invert-scroll-y;  // 휠 Y 축 반전
        mode = <PIM447_SCROLL>; // 시작 시 마우스 휠로 작동
    };
};
